## caos-buildroot/package/caos-syslinux/Config.in.host
```kconfig
config BR2_PACKAGE_HOST_CAOS_SYSLINUX
	bool "caos syslinux installer"
	depends on BR2_HOST_GCC_AT_LEAST_5
	help
	  Host-side SYSLINUX installer used to install the extlinux boot
	  sector and ldlinux.sys into the FAT boot partition without root
	  privileges.  The installer uses mtools (selected by the package
	  dependency) and never mounts the filesystem.

	  This is a CAOS-specific host tool; it is not installed in the
	  target root filesystem.
```
